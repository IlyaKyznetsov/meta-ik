## conf/distro/void.conf
```bitbake
require conf/distro/poky-tiny.conf
DISTRO = "void"
DISTROOVERRIDES = "poky:void"

PREFERRED_PROVIDER_virtual/kernel = "linux-dummy"
PREFERRED_VERSION_linux-yocto = ""
PREFERRED_VERSION_linux-yocto-tiny = ""
#PREFERRED_PROVIDER_udev="udev"

TCLIBC = "glibc"
DISTRO_FEATURES_append=" ${DISTRO_FEATURES_LIBC}"
#TCLIBC = "musl"
#TCLIBC = "newlib"
#TCLIBC = "baremetal"

IMAGE_FSTYPES = "tar.gz"
QB_DEFAULT_FSTYPE = "${IMAGE_FSTYPES}"

DISTRO_FEATURES = ""
DISTRO_FEATURES_append = "ipv4 ipv6 usbgadget usbhost largefile"

# Enable SysVinit (poky/meta/conf/distro/defaultsetup.conf)
DISTRO_FEATURES_append = " sysvinit"
DISTRO_FEATURES_BACKFILL_CONSIDERED_append = " systemd"
VIRTUAL-RUNTIME_init_manager = "sysvinit"
VIRTUAL-RUNTIME_initscripts = "initscripts"
VIRTUAL-RUNTIME_dev_manager = "udev"
VIRTUAL-RUNTIME_login_manager = "shadow-base"
#PREFERRED_PROVIDER_virtual/base-utils = "coreutils"
#VIRTUAL-RUNTIME_base-utils = "coreutils"
VIRTUAL-RUNTIME_base-utils = "busybox"
VIRTUAL-RUNTIME_base-utils-hwclock = "busybox-hwclock"
VIRTUAL-RUNTIME_base-utils-syslog = "busybox-syslog"

DISTRO_FEATURES_append = " alsa"
DISTRO_FEATURES_BACKFILL_CONSIDERED_append = " pulseaudio"

# Disable python usage in opkg-utils since it won't build with tiny config
PACKAGECONFIG_remove_pn-opkg-utils = "python"
```

## conf/machine/cortexa8.conf
```bitbake
include conf/machine/include/tune-cortexa8.inc
#PREFERRED_PROVIDER_virtual/kernel = "linux-dummy"
#PREFERRED_PROVIDER_virtual/kernel = ""
COMPATIBLE_MACHINE_cortexa8 = "cortexa8"
```

## conf/machine/cortexa9.conf
```bitbake
include conf/machine/include/tune-cortexa9.inc
#PREFERRED_PROVIDER_virtual/kernel = "linux-dummy"
#PREFERRED_PROVIDER_virtual/kernel = ""
COMPATIBLE_MACHINE_cortexa9 = "cortexa9"
```
